## conf/layer.conf
```bitbake
# We have a conf and classes directory, add to BBPATH
BBPATH .= ":${LAYERDIR}"

# We have recipes-* directories, add to BBFILES
BBFILES += "${LAYERDIR}/recipes-*/*/*.bb \
            ${LAYERDIR}/recipes-*/*/*.bbappend"

BBFILE_COLLECTIONS += "meta-realtek-matter"
BBFILE_PATTERN_meta-realtek-matter = "^${LAYERDIR}/"
BBFILE_PRIORITY_meta-realtek-matter = "9"

LAYERDEPENDS_meta-realtek-matter = "core"
LAYERSERIES_COMPAT_meta-realtek-matter = "kirkstone"

# List the packages you want to install using IMAGE_INSTALL variable
# Examples of packages you may want: matter matter-ported-examples matter-custom-dac-examples
IMAGE_INSTALL += "matter chip-tool"
```
